## drivers/ipm/Kconfig
```kconfig
# SPDX-License-Identifier: Apache-2.0

menuconfig IPM
	bool "Inter-Processor Mailbox (IPM) drivers"
	help
	  Include interrupt-based inter-processor mailboxes
	  drivers in system configuration

if IPM

config SOPHGO_CV180X_IPM
	bool "Sophgo CV180X IPM driver"
	default y
	depends on DT_HAS_SOPHGO_CV180X_IPM_ENABLED
	help
	  Interprocessor mailbox  driver for Sophgo CV180x.

module = IPM
module-str = ipm
source "subsys/logging/Kconfig.template.log_config"

endif #IPM
```

## west.yml
```yaml
# Copyright (c) 2021 Nordic Semiconductor ASA
# SPDX-License-Identifier: Apache-2.0

manifest:
  self:
    west-commands: scripts/west-commands.yml

  remotes:
    # Add a new remote for the forked Zephyr repository with milkv-duo support
    - name: xingrz-zephyr 
      url-base: https://github.com/xingrz

    # or use the official Zephyr repository with revision: pull/69594/head
    - name: zephyrproject-rtos
      url-base: https://github.com/zephyrproject-rtos
  
  projects:
    - name: zephyr
      remote: zephyrproject-rtos
      revision: pull/69594/head
      clone-depth: 1
      import:
        # By using name-allowlist we can clone only the modules that are
        # strictly needed by the application.
        name-allowlist:
          - open-amp
          - libmetal
          - tflite-micro
```
