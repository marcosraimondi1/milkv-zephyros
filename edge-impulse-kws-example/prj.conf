## CMakeLists.txt
```
cmake_minimum_required(VERSION 3.13.1)

set(CMAKE_CXX_STANDARD 11)
set(CMAKE_CXX_STANDARD_REQUIRED ON)

find_package(Zephyr REQUIRED HINTS $ENV{ZEPHYR_BASE})

project(example-standalone-inferencing-zephyr)

include(utils/cmake/utils.cmake)

# Needed for colorful output
zephyr_compile_options(-fdiagnostics-color=always)

# Use hardware acceleration for DSP and Neural Network code
# You'll need to disable these on non-Arm cores
# add_definitions(-DEI_CLASSIFIER_TFLITE_ENABLE_CMSIS_NN=1
#                 -DARM_MATH_LOOPUNROLL
#                 )

# Add the Edge Impulse SDK
add_subdirectory(edge-impulse-sdk/cmake/zephyr)

# Edge impulse SDK include directories
set(INCLUDES
    .
    src
    tflite-model
    model-parameters
    )
include_directories(${INCLUDES})

RECURSIVE_FIND_FILE(MODEL_FILES "tflite-model" "*.cpp")
list(APPEND SOURCE_FILES ${MODEL_FILES})

# add all sources to the project
target_sources(app PRIVATE ${SOURCE_FILES})
target_sources(app PRIVATE src/main.cpp)
```

## prj.conf
```kconfig
CONFIG_GPIO=y
# enable c++ support
CONFIG_CPP=y
CONFIG_GLIBCXX_LIBCPP=y
CONFIG_NEWLIB_LIBC=y
CONFIG_NEWLIB_LIBC_FLOAT_PRINTF=y
CONFIG_FPU=y
CONFIG_CBPRINTF_FULL_INTEGRAL=y
CONFIG_CBPRINTF_FP_SUPPORT=y

CONFIG_MAIN_STACK_SIZE=8192
CONFIG_CONSOLE_SUBSYS=y
CONFIG_CONSOLE_GETLINE=y

# Logging
CONFIG_LOG=y
CONFIG_ASSERT=y
CONFIG_LOG_PROCESS_THREAD_STACK_SIZE=1024
```

## src/main.cpp
```c
// Zpehyr 3.1.x and newer uses different include scheme
#include <zephyr/kernel.h>
#include "edge-impulse-sdk/classifier/ei_run_classifier.h"
#include <zephyr/drivers/gpio.h>
#include "adc.h"
#include "pin.h"
#include "timer.h"

// registers
#define ADC_PIN_MUX_OFFSET 0x0F8
#define ADC_PIN_FUNC       3U

// devicetree
#define PIN_MUX_BASE       (uint32_t)DT_REG_ADDR(DT_NODELABEL(pinctrl))
#define ADC_BASE           (uint32_t)DT_REG_ADDR(DT_ALIAS(myadc))
#define TIMER_BASE         (uint32_t)DT_REG_ADDR(DT_ALIAS(mytimer))
#define TIMER_IRQN         DT_IRQN(DT_ALIAS(mytimer))
#define TIMER_IRQ_PRIORITY DT_IRQ(DT_ALIAS(mytimer), priority)
#define LED0_NODE          DT_ALIAS(led0)
static const struct gpio_dt_spec led = GPIO_DT_SPEC_GET(LED0_NODE, gpios);

// constants
#define TIMER_ID          5
#define NSAMPLES          16000
#define TIMER_CLK_FREQ_HZ 25000000
#define SAMPLING_FREQ_HZ  16000
#define TIMER_COUNT       (TIMER_CLK_FREQ_HZ / SAMPLING_FREQ_HZ) - 1

// variables
static float features[NSAMPLES] = {0};
static int count = 0;

void led_countdown(int countdown_s);
int raw_feature_get_data(size_t offset, size_t length, float *out_ptr);
static void infer();
void get_audio();

int main()
{
	printk("Edge Impulse standalone inferencing (Zephyr)\n");
	setvbuf(stdout, NULL, _IONBF, 0);

	if (sizeof(features) / sizeof(float) != EI_CLASSIFIER_DSP_INPUT_FRAME_SIZE) {
		printk("The size of your 'features' array is not correct. Expected %d items, but "
		       "had %lu\n",
		       EI_CLASSIFIER_DSP_INPUT_FRAME_SIZE, sizeof(features) / sizeof(float));
		return 1;
	}

	while (1) {
		led_countdown(3);
		get_audio();
		infer();
	}
}

void timer_stop()
{
	// disable timer
	hal_timer_disable_clk(TIMER_ID);
	TIMER_CTRL(TIMER_BASE) &= ~1;
}

void adc_stop()
{
	hal_adc_reset_sel_channel(ADC_BASE, ADC_CHANNEL_SEL_Msk);
	hal_adc_stop(ADC_BASE);
	hal_adc_disable_clk();
}

static void timer_isr()
{
	static bool first = true;
	if (TIMER_INTR_STA(TIMER_BASE) & 1) {
		volatile int32_t a = TIMER_INTR_CLR(TIMER_BASE);
		ARG_UNUSED(a); // clear interrupt

		if (first) {
			first = false;
			hal_adc_start(ADC_BASE); // start conversion
			return;
		}

		if (hal_adc_get_data_ready(ADC_BASE)) {
			features[count] = hal_adc_get_channel1_data(ADC_BASE) & 0xFFF;

			if (hal_adc_get_channel1_data_valid(ADC_BASE) == 0) {
				printk("ADC data is invalid\n");
				while (1) {
				}
			}

			count += 1;
			if (count >= NSAMPLES) {
				timer_stop();
				adc_stop();
				return;
			}
			hal_adc_start(ADC_BASE); // start conversion
		} else {
			printk("ADC data is not ready\n");
			while (1) {
			}
		}
	}
	return;
}

void irq_config(void)
{
	// Conectar la interrupcion (agrega a la tabla de interrupciones)
	IRQ_CONNECT(TIMER_IRQN, TIMER_IRQ_PRIORITY, timer_isr, NULL, 0);
	irq_enable(TIMER_IRQN);
}

void timer_init(uint32_t load_count)
{
	// peripheral clock is 25MHz, 1s = 25M counts
	// disable timer
	hal_timer_disable_clk(TIMER_ID);
	TIMER_CTRL(TIMER_BASE) &= ~1;
	volatile int32_t a = TIMER_INTR_CLR(TIMER_BASE);
	ARG_UNUSED(a);

	// config timer
	TIMER_LOAD_COUNT(TIMER_BASE) = load_count;
	TIMER_CTRL(TIMER_BASE) &= ~(1 << 2); // interrupt not masked
	TIMER_CTRL(TIMER_BASE) |= 1 << 1;    // user-defined mode

	// enable timer
	hal_timer_enable_clk(TIMER_ID);
	TIMER_CTRL(TIMER_BASE) |= 1;
}

void adc_init()
{
	uint8_t ch_id = 1;
	pin_set_mux(PIN_MUX_BASE + ADC_PIN_MUX_OFFSET, ADC_PIN_FUNC);
	hal_adc_enable_clk();
	hal_adc_set_sel_channel(ADC_BASE, (uint32_t)1U << (ADC_CTRL_ADC_SEL_Pos + ch_id));
	hal_adc_cyc_setting(ADC_BASE);
}

void get_audio()
{
	gpio_pin_set_dt(&led, 1);
	adc_init();
	timer_init(TIMER_COUNT);
	irq_config();
	while (count < NSAMPLES) {
		k_sleep(K_MSEC(100));
	}
	count = 0;
	gpio_pin_set_dt(&led, 0);
}

void led_countdown(int countdown_s)
{
	gpio_pin_configure_dt(&led, GPIO_OUTPUT_ACTIVE);
	for (int i = 0; i < countdown_s; i++) {
		gpio_pin_set_dt(&led, 1);
		k_sleep(K_MSEC(500));
		gpio_pin_set_dt(&led, 0);
		k_sleep(K_MSEC(500));
	}
}

static void infer()
{
	ei_impulse_result_t result = {0};
	signal_t features_signal;
	features_signal.total_length = sizeof(features) / sizeof(features[0]);
	features_signal.get_data = &raw_feature_get_data;

	// invoke the impulse
	printk("Running the impulse...\n");
	EI_IMPULSE_ERROR res = run_classifier(&features_signal, &result, false);

	if (res != 0) {
		printk("ERR: Failed to run classifier (%d)\n", res);
		return;
	}

	printk("Predictions (DSP: %d ms., Classification: %d ms., Anomaly: %d ms.): \n",
	       result.timing.dsp, result.timing.classification, result.timing.anomaly);

	for (size_t ix = 0; ix < EI_CLASSIFIER_LABEL_COUNT; ix++) {
		printk("    %s: %f\n", result.classification[ix].label,
		       (double)result.classification[ix].value);
	}
}

int raw_feature_get_data(size_t offset, size_t length, float *out_ptr)
{
	memcpy(out_ptr, features + offset, length * sizeof(float));
	return 0;
}
```

## src/adc.h
```c
/*
 * Copyright (C) Cvitek Co., Ltd. 2019-2020. All rights reserved.
 */

#ifndef __CVI_ADC_H__
#define __CVI_ADC_H__

#include <stdint.h>

#ifdef __cplusplus
extern "C" {
#endif

/* CTRL REG */
#define ADC_CTRL_ADC_START_Pos (0U)
#define ADC_CTRL_ADC_START_Msk (1U << ADC_CTRL_ADC_START_Pos)
#define ADC_CTRL_ADC_START     ADC_CTRL_ADC_START_Msk

#define ADC_CTRL_ADC_SEL_Pos     (4U)
#define ADC_CHANNEL_SEL_Msk      (0xF << ADC_CTRL_ADC_SEL_Pos)
#define ADC_CHANNEL_SEL_1        (1U << (ADC_CTRL_ADC_SEL_Pos + 1U))
#define ADC_CHANNEL_SEL_2        (1U << (ADC_CTRL_ADC_SEL_Pos + 2U))
#define ADC_CHANNEL_SEL_3        (1U << (ADC_CTRL_ADC_SEL_Pos + 3U))
#define ADC_CHANNEL_SEL_CH(_ch_) (1U << (ADC_CTRL_ADC_SEL_Pos + _ch_))

/* STATUS REG */
#define ADC_STATUS_ADC_BUSY_Pos (0U)
#define ADC_STATUS_ADC_BUSY_Msk (0x1U << ADC_STATUS_ADC_BUSY_Pos)

/* CYC_SET REG */
#define ADC_CYC_SET_ADC_CYC_CLK_DIV_Pos (12U)
#define ADC_CYC_SET_ADC_CYC_CLK_DIV_Msk (0xF << ADC_CYC_SET_ADC_CYC_CLK_DIV_Pos)
#define ADC_CYC_SET_ADC_CYC_CLK_DIV_1   (0U << ADC_CYC_SET_ADC_CYC_CLK_DIV_Pos)
#define ADC_CYC_SET_ADC_CYC_CLK_DIV_2   (1U << ADC_CYC_SET_ADC_CYC_CLK_DIV_Pos)
#define ADC_CYC_SET_ADC_CYC_CLK_DIV_3   (2U << ADC_CYC_SET_ADC_CYC_CLK_DIV_Pos)
#define ADC_CYC_SET_ADC_CYC_CLK_DIV_4   (3U << ADC_CYC_SET_ADC_CYC_CLK_DIV_Pos)
#define ADC_CYC_SET_ADC_CYC_CLK_DIV_5   (4U << ADC_CYC_SET_ADC_CYC_CLK_DIV_Pos)
#define ADC_CYC_SET_ADC_CYC_CLK_DIV_6   (5U << ADC_CYC_SET_ADC_CYC_CLK_DIV_Pos)
#define ADC_CYC_SET_ADC_CYC_CLK_DIV_7   (6U << ADC_CYC_SET_ADC_CYC_CLK_DIV_Pos)
#define ADC_CYC_SET_ADC_CYC_CLK_DIV_8   (7U << ADC_CYC_SET_ADC_CYC_CLK_DIV_Pos)
#define ADC_CYC_SET_ADC_CYC_CLK_DIV_9   (8U << ADC_CYC_SET_ADC_CYC_CLK_DIV_Pos)
#define ADC_CYC_SET_ADC_CYC_CLK_DIV_10  (9U << ADC_CYC_SET_ADC_CYC_CLK_DIV_Pos)
#define ADC_CYC_SET_ADC_CYC_CLK_DIV_11  (10U << ADC_CYC_SET_ADC_CYC_CLK_DIV_Pos)
#define ADC_CYC_SET_ADC_CYC_CLK_DIV_12  (11U << ADC_CYC_SET_ADC_CYC_CLK_DIV_Pos)
#define ADC_CYC_SET_ADC_CYC_CLK_DIV_13  (12U << ADC_CYC_SET_ADC_CYC_CLK_DIV_Pos)
#define ADC_CYC_SET_ADC_CYC_CLK_DIV_14  (13U << ADC_CYC_SET_ADC_CYC_CLK_DIV_Pos)
#define ADC_CYC_SET_ADC_CYC_CLK_DIV_15  (14U << ADC_CYC_SET_ADC_CYC_CLK_DIV_Pos)
#define ADC_CYC_SET_ADC_CYC_CLK_DIV_16  (15U << ADC_CYC_SET_ADC_CYC_CLK_DIV_Pos)

#define ADC_CYC_SET_ADC_CYC_SAMPLE_Pos (8U)
#define ADC_CYC_SET_ADC_CYC_SAMPLE_Msk (0xF << ADC_CYC_SET_ADC_CYC_SAMPLE_Pos)

/* INT_EN REG */
#define ADC_EN_ALL_CHANNEL_DONE_Pos (0U)
#define ADC_EN_ALL_CHANNEL_DONE_Msk (1U << ADC_EN_ALL_CHANNEL_DONE_Pos)
#define ADC_EN_ALL_CHANNEL_DONE_EN  ADC_EN_ALL_CHANNEL_DONE_Msk

/* INT_STATUS, offset: 0x14 */
#define ADC_INT_ALL_CONNNEL_DONE_Pos (0U)
#define ADC_INT_ALL_CONNNEL_DONE_Msk (1U << ADC_INT_ALL_CONNNEL_DONE_Pos)
#define ADC_INT_ALL_CONNNEL_DONE     ADC_INT_ALL_CONNNEL_DONE_Msk

/* ADC_DATA, offset: 0x18 */
#define ADC_DATA_Pos (0U)
#define ADC_DATA_Msk (0xFFFU << ADC_DATA_Pos)

/* ANA_REGISTER, offset: 0x30 */
#define ADC_EN_Pos (0U)
#define ADC_EN_Msk (0x1U << ADC_EN_Pos)
#define ADC_EN     ADC_EN_Msk

#define ADC_INTR_Pos (0U)
#define ADC_INTR_Msk (1U << ADC_INTR_Pos)
#define ADC_INTR_En  ADC_INTR_Msk

struct cvi_adc_regs_t {
	uint32_t CTRL;
	uint32_t STATUS;
	uint32_t CYC_SET;
	uint32_t CH1_RESULT;
	uint32_t CH2_RESULT;
	uint32_t CH3_RESULT;
	uint32_t INTR_EN;
	uint32_t INTR_CLR;
	uint32_t INTR_STA;
	uint32_t INTR_RAW;
};

static struct cvi_adc_regs_t cv182x_adc_reg = {
	.CTRL = 0x4,
	.STATUS = 0x8,
	.CYC_SET = 0xc,
	.CH1_RESULT = 0x14,
	.CH2_RESULT = 0x18,
	.CH3_RESULT = 0x1c,
	.INTR_EN = 0x20,
	.INTR_CLR = 0x24,
	.INTR_STA = 0x28,
	.INTR_RAW = 0x2c,
};

static struct cvi_adc_regs_t *cvi_adc_reg = &cv182x_adc_reg;

#define ADC_CTRL(reg_base)    *((uint32_t *)(reg_base + cvi_adc_reg->CTRL))
#define ADC_STATUS(reg_base)  *((uint32_t *)(reg_base + cvi_adc_reg->STATUS))
#define ADC_CYC_SET(reg_base) *((uint32_t *)(reg_base + cvi_adc_reg->CYC_SET))

#define ADC_CH1_RESULT(reg_base) *((uint32_t *)(reg_base + cvi_adc_reg->CH1_RESULT))
#define ADC_CH2_RESULT(reg_base) *((uint32_t *)(reg_base + cvi_adc_reg->CH2_RESULT))
#define ADC_CH3_RESULT(reg_base) *((uint32_t *)(reg_base + cvi_adc_reg->CH3_RESULT))
#define ADC_RESULT_CH(reg_base, _ch_)                                                              \
	*((uint32_t *)(reg_base + cvi_adc_reg->CH1_RESULT + (_ch_ - 1) * 4))

#define ADC_INTR_EN(reg_base)  *((uint32_t *)(reg_base + cvi_adc_reg->INTR_EN))
#define ADC_INTR_CLR(reg_base) *((uint32_t *)(reg_base + cvi_adc_reg->INTR_CLR))
#define ADC_INTR_STA(reg_base) *((uint32_t *)(reg_base + cvi_adc_reg->INTR_STA))
#define ADC_INTR_RAW(reg_base) *((uint32_t *)(reg_base + cvi_adc_reg->INTR_RAW))

#define ADC_CLK *((uint32_t *)(0x3002000))

static inline void hal_adc_enable_clk()
{
	ADC_CLK |= (1U << 10);
}

static inline void hal_adc_disable_clk()
{
	ADC_CLK &= ~(1U << 10);
}

static inline void hal_adc_cyc_setting(unsigned long reg_base)
{
	ADC_CYC_SET(reg_base) &= ~ADC_CYC_SET_ADC_CYC_CLK_DIV_1;
	ADC_CYC_SET(reg_base) |=
		ADC_CYC_SET_ADC_CYC_CLK_DIV_1; // set saradc freq = ip_clk / (1+clk_div)
}

static inline void hal_adc_start(unsigned long reg_base)
{
	ADC_CTRL(reg_base) |= ADC_CTRL_ADC_START;
}

static inline uint32_t hal_adc_get_start(unsigned long reg_base)
{
	return (ADC_CTRL(reg_base) & ADC_CTRL_ADC_START_Msk);
}

static inline void hal_adc_stop(unsigned long reg_base)
{
	ADC_CTRL(reg_base) &= ~ADC_CTRL_ADC_START;
}

static inline uint32_t hal_adc_get_stop(unsigned long reg_base)
{
	return (ADC_CTRL(reg_base) & ADC_CTRL_ADC_START_Msk);
}

static inline uint32_t hal_adc_get_data_ready(unsigned long reg_base)
{
	return !(ADC_STATUS(reg_base) & ADC_STATUS_ADC_BUSY_Msk);
}

static inline uint32_t hal_adc_get_idle(unsigned long reg_base)
{
	return !(ADC_STATUS(reg_base) & ADC_STATUS_ADC_BUSY_Msk);
}

static inline void hal_adc_set_sel_channel(unsigned long reg_base, uint32_t value)
{
	ADC_CTRL(reg_base) |= value;
}

static inline void hal_adc_reset_sel_channel(unsigned long reg_base, uint32_t value)
{
	ADC_CTRL(reg_base) &= ~value;
}

static inline uint32_t hal_adc_get_sel_channel(unsigned long reg_base)
{
	return (ADC_CTRL(reg_base) & ADC_CHANNEL_SEL_Msk);
}

static inline void hal_adc_set_clk_div(unsigned long reg_base, uint32_t value)
{
	ADC_CYC_SET(reg_base) &= ~ADC_CYC_SET_ADC_CYC_CLK_DIV_Msk;
	ADC_CYC_SET(reg_base) |= (value << ADC_CYC_SET_ADC_CYC_CLK_DIV_Pos);
}
static inline uint32_t hal_adc_get_clk_div(unsigned long reg_base)
{
	return (ADC_CYC_SET(reg_base) & ADC_CYC_SET_ADC_CYC_CLK_DIV_Msk);
}

static inline void hal_adc_set_sample_cycle(unsigned long reg_base, uint32_t value)
{
	ADC_CYC_SET(reg_base) &= ~ADC_CYC_SET_ADC_CYC_SAMPLE_Msk;
	ADC_CYC_SET(reg_base) |= (value << ADC_CYC_SET_ADC_CYC_SAMPLE_Pos);
}

static inline void hal_adc_en_int_all_channel_done(unsigned long reg_base)
{
	ADC_INTR_EN(reg_base) |= ADC_EN_ALL_CHANNEL_DONE_EN;
}

static inline void hal_adc_dis_int_all_channel_done(unsigned long reg_base)
{
	ADC_INTR_EN(reg_base) &= ~ADC_EN_ALL_CHANNEL_DONE_EN;
}

static inline void hal_adc_int_en(unsigned long reg_base)
{
	ADC_INTR_EN(reg_base) |= ADC_INTR_En;
}

static inline void hal_adc_int_dis(unsigned long reg_base)
{
	ADC_INTR_EN(reg_base) &= ~ADC_INTR_En;
}

static inline uint32_t hal_adc_get_int_flag(unsigned long reg_base)
{
	return (ADC_INTR_STA(reg_base) & ADC_EN_ALL_CHANNEL_DONE_Msk);
}

static inline void hal_adc_clear_int_flag(unsigned long reg_base)
{
	ADC_INTR_CLR(reg_base) |= ADC_EN_ALL_CHANNEL_DONE_EN;
}

static inline bool hal_adc_get_channel1_data_valid(unsigned long reg_base)
{
	return (ADC_CH1_RESULT(reg_base) & (1 << 15));
}

static inline uint32_t hal_adc_get_channel1_data(unsigned long reg_base)
{
	return (ADC_CH1_RESULT(reg_base) & ADC_DATA_Msk);
}

static inline uint32_t hal_adc_get_channel2_data(unsigned long reg_base)
{
	return (ADC_CH2_RESULT(reg_base) & ADC_DATA_Msk);
}

static inline uint32_t hal_adc_get_channel3_data(unsigned long reg_base)
{
	return (ADC_CH3_RESULT(reg_base) & ADC_DATA_Msk);
}

static inline uint32_t hal_adc_get_channel_data_ch(unsigned long reg_base, uint32_t ch)
{
	return (ADC_RESULT_CH(reg_base, ch) & ADC_DATA_Msk);
}

#ifdef __cplusplus
}
#endif

#endif /* _CVI_ADC_LL_H_*/
```
